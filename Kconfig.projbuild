## Kconfig.projbuild
```kconfig
menu "micro-ROS Settings"

#####################################
#    CHOOSE MICRO-ROS MIDDLEWARE    #
#####################################

choice
    prompt "micro-ROS middleware"
    default MICRO_ROS_ESP_XRCE_DDS_MIDDLEWARE
    config  MICRO_ROS_ESP_XRCE_DDS_MIDDLEWARE
        bool "micro-ROS over eProsima Micro XRCE-DDS"
    config  MICRO_ROS_ESP_EMBEDDEDRTPS_MIDDLEWARE
        bool "micro-ROS over embeddedRTPS (EXPERIMENTAL)"
endchoice

##################################
#    CHOOSE NETWORK INTERFACE    #
##################################

choice
    prompt "micro-ROS network interface select"
    config  MICRO_ROS_ESP_NETIF_WLAN
        bool "WLAN interface"
    config  MICRO_ROS_ESP_NETIF_ENET
        bool "Ethernet interface"
if MICRO_ROS_ESP_XRCE_DDS_MIDDLEWARE
    config  MICRO_ROS_ESP_UART_TRANSPORT
        bool "Micro XRCE-DDS over UART. Check int32_publisher_custom_transport"
endif
endchoice


#####################
#    WLAN CONFIG    #
#####################

if MICRO_ROS_ESP_NETIF_WLAN

menu "WiFi Configuration"

    config ESP_WIFI_SSID
        string "WiFi SSID"
        default "myssid"
        help
            SSID (network name) for the example to connect to.

    config ESP_WIFI_PASSWORD
        string "WiFi Password"
        default "mypassword"
        help
            WiFi password (WPA or WPA2) for the example to use.

    config ESP_MAXIMUM_RETRY
        int "Maximum retry"
        default 5
        help
            Set the Maximum retry to avoid station reconnecting to the AP unlimited when the AP is really inexistent.
endmenu

endif # MICRO_ROS_ESP_NETIF_WLAN

#########################
#    ETHERNET CONFIG    #
#########################

if MICRO_ROS_ESP_NETIF_ENET

menu "Ethernet Configuration"
    config MICRO_ROS_USE_SPI_ETHERNET
        bool

    choice MICRO_ROS_ETHERNET_TYPE
        prompt "Ethernet Type"
        default MICRO_ROS_USE_INTERNAL_ETHERNET if IDF_TARGET_ESP32
        default MICRO_ROS_USE_W5500
        help
            Select which kind of Ethernet will be used in the example.

        config MICRO_ROS_USE_INTERNAL_ETHERNET
            depends on IDF_TARGET_ESP32
            select ETH_USE_ESP32_EMAC
            bool "Internal EMAC"
            help
                Select internal Ethernet MAC controller.

        config MICRO_ROS_USE_DM9051
            bool "DM9051 Module"
            select MICRO_ROS_USE_SPI_ETHERNET
            select ETH_USE_SPI_ETHERNET
            select ETH_SPI_ETHERNET_DM9051
            help
                Select external SPI-Ethernet module (DM9051).

        config MICRO_ROS_USE_W5500
            bool "W5500 Module"
            select MICRO_ROS_USE_SPI_ETHERNET
            select ETH_USE_SPI_ETHERNET
            select ETH_SPI_ETHERNET_W5500
            help
                Select external SPI-Ethernet module (W5500).
    endchoice # MICRO_ROS_ETHERNET_TYPE

    if MICRO_ROS_USE_INTERNAL_ETHERNET
        choice MICRO_ROS_ETH_PHY_MODEL
            prompt "Ethernet PHY Device"
            default MICRO_ROS_ETH_PHY_IP101
            help
                Select the Ethernet PHY device to use in the example.

            config MICRO_ROS_ETH_PHY_IP101
                bool "IP101"
                help
                    IP101 is a single port 10/100 MII/RMII/TP/Fiber Fast Ethernet Transceiver.
                    Goto http://www.icplus.com.tw/pp-IP101G.html for more information about it.

            config MICRO_ROS_ETH_PHY_RTL8201
                bool "RTL8201/SR8201"
                help
                    RTL8201F/SR8201F is a single port 10/100Mb Ethernet Transceiver with auto MDIX.
                    Goto http://www.corechip-sz.com/productsview.asp?id=22 for more information about it.

            config MICRO_ROS_ETH_PHY_LAN8720
                bool "LAN8720"
                help
                    LAN8720A is a small footprint RMII 10/100 Ethernet Transceiver with HP Auto-MDIX Support.
                    Goto https://www.microchip.com/LAN8720A for more information about it.

            config MICRO_ROS_ETH_PHY_DP83848
                bool "DP83848"
                help
                    DP83848 is a single port 10/100Mb/s Ethernet Physical Layer Transceiver.
                    Goto http://www.ti.com/product/DP83848J for more information about it.

            config MICRO_ROS_ETH_PHY_KSZ8041
                bool "KSZ8041"
                help
                    The KSZ8041 is a single supply 10Base-T/100Base-TX Physical Layer Transceiver.
                    Goto https://www.microchip.com/wwwproducts/en/KSZ8041 for more information about it.
        endchoice # MICRO_ROS_ETH_PHY_MODEL

        config MICRO_ROS_ETH_MDC_GPIO
            int "SMI MDC GPIO number"
            default 23
            help
                Set the GPIO number used by SMI MDC.

        config MICRO_ROS_ETH_MDIO_GPIO
            int "SMI MDIO GPIO number"
            default 18
            help
                Set the GPIO number used by SMI MDIO.
    endif # MICRO_ROS_USE_INTERNAL_ETHERNET

    if MICRO_ROS_USE_SPI_ETHERNET
        config MICRO_ROS_ETH_SPI_HOST
            int "SPI Host Number"
            range 0 2
            default 1
            help
                Set the SPI host used to communicate with the SPI Ethernet Controller.

        config MICRO_ROS_ETH_SPI_SCLK_GPIO
            int "SPI SCLK GPIO number"
            range 0 33
            default 20
            help
                Set the GPIO number used by SPI SCLK.

        config MICRO_ROS_ETH_SPI_MOSI_GPIO
            int "SPI MOSI GPIO number"
            range 0 33
            default 19
            help
                Set the GPIO number used by SPI MOSI.

        config MICRO_ROS_ETH_SPI_MISO_GPIO
            int "SPI MISO GPIO number"
            range 0 33
            default 18
            help
                Set the GPIO number used by SPI MISO.

        config MICRO_ROS_ETH_SPI_CS_GPIO
            int "SPI CS GPIO number"
            range 0 33
            default 21
            help
                Set the GPIO number used by SPI CS.

        config MICRO_ROS_ETH_SPI_CLOCK_MHZ
            int "SPI clock speed (MHz)"
            range 5 80
            default 36
            help
                Set the clock speed (MHz) of SPI interface.

        config MICRO_ROS_ETH_SPI_INT_GPIO
            int "Interrupt GPIO number"
            default 4
            help
                Set the GPIO number used by the SPI Ethernet module interrupt line.
    endif # MICRO_ROS_USE_SPI_ETHERNET

    config MICRO_ROS_ETH_PHY_RST_GPIO
        int "PHY Reset GPIO number"
        default 5
        help
            Set the GPIO number used to reset PHY chip.
            Set to -1 to disable PHY chip hardware reset.

    config MICRO_ROS_ETH_PHY_ADDR
        int "PHY Address"
        range 0 31
        default 1
        help
            Set PHY address according your board schematic.
endmenu

endif # MICRO_ROS_ESP_NETIF_ENET

#########################
#    XRCE-DDS CONFIG    #
#########################

if MICRO_ROS_ESP_XRCE_DDS_MIDDLEWARE && !MICRO_ROS_ESP_UART_TRANSPORT

config MICRO_ROS_AGENT_IP
    string "micro-ROS Agent IP"
    default "192.168.1.100"
    help
        micro-ROS Agent IP.

config MICRO_ROS_AGENT_PORT
    string "micro-ROS Agent Port"
    default "8888"
    help
        micro-ROS Agent port.

endif


#####################
#    UART CONFIG    #
#####################

if MICRO_ROS_ESP_UART_TRANSPORT
menu "UART Settings"

config MICROROS_UART_TXD
    int "UART TX pin"
    range -1 33
    default -1
    help
        Select Tx Down pin for uart connection or -1 for no change (Only used if serial transport is used for microros).

config MICROROS_UART_RXD
    int "UART RX pin"
    range -1 33
    default -1
    help
        Select Rx Down pin for uart connection or -1 for no change (Only used if serial transport is used for microros).

config MICROROS_UART_RTS
    int "UART RTS pin"
    range -1 33
    default -1
    help
        Select RTS Down pin for uart connection or -1 for no change (Only used if serial transport is used for microros).

config MICROROS_UART_CTS
    int "UART CTS pin"
    range -1 33
    default -1
    help
        Select CTS Down pin for uart connection or -1 for no change (Only used if serial transport is used for microros).

endmenu

endif # MICRO_ROS_ESP_UART_TRANSPORT

endmenu
```

## examples/int32_publisher_custom_transport/sdkconfig.defaults
```kconfig
CONFIG_ESP_MAIN_TASK_STACK_SIZE=3000
CONFIG_ESP_TASK_WDT=n
CONFIG_MICRO_ROS_ESP_XRCE_DDS_MIDDLEWARE=y
CONFIG_MICRO_ROS_ESP_UART_TRANSPORT=y
```

## examples/int32_publisher_custom_transport_usbcdc/main/Kconfig.projbuild
```kconfig
menu "micro-ROS example-app settings"

    config MICRO_ROS_APP_STACK
        int "Stack the micro-ROS app (Bytes)"
        default 16000
        help
        Stack size in Bytes of the micro-ROS app

    config MICRO_ROS_APP_TASK_PRIO
        int "Priority of the micro-ROS app"
        default 5
        help
        Priority of micro-ros task higher value means higher priority
        
endmenu
```

## examples/low_consumption/sdkconfig.defaults
```kconfig
CONFIG_PM_ENABLE=y
CONFIG_PM_DFS_INIT_AUTO=y
CONFIG_FREERTOS_USE_TICKLESS_IDLE=y
CONFIG_ESP_MAIN_TASK_STACK_SIZE=3000
CONFIG_ESP_TASK_WDT=n
```

## examples/multithread_publisher/sdkconfig.defaults
```kconfig
CONFIG_ESP_MAIN_TASK_STACK_SIZE=3000
CONFIG_ESP_TASK_WDT=n
CONFIG_FREERTOS_SUPPORT_STATIC_ALLOCATION=y
```
